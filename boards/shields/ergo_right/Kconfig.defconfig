## config/boards/shields/ergo_left/Kconfig.defconfig
```kconfig
if SHIELD_ERGO_LEFT

config ZMK_KEYBOARD_NAME
    default "Ergo Left"

config I2C
    default y

config GPIO_MCP230XX
    default y

endif
```

## config/west.yml
```yaml
manifest:
  remotes:
    - name: zmkfirmware
      url-base: https://github.com/zmkfirmware
    # Uncomment the line below once you've decided to use the Azoteq
    # trackpad driver and have wired up its RST pin (see overlay).
    # - name: AYM1607
    #   url-base: https://github.com/AYM1607
  projects:
    - name: zmk
      remote: zmkfirmware
      revision: main
      import: app/west.yml
    # Uncomment the block below in tandem with the AYM1607 remote above:
    # - name: zmk-driver-azoteq-iqs5xx
    #   remote: AYM1607
    #   revision: main
  self:
    path: config
```
